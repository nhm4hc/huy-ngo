#include<reg51.h>
#include<intrins.h>

sbit module11_SRCLK = P3^6;
sbit module11_RCLK = P3^5;
sbit module11_SER = P3^4;

#define COMMONPORTS P0
#define TAB_length 8
#define CHARCADE_rowLength 18
#define CHARCADE_columnLength 8

unsigned char code TAB[TAB_length]  = {0x7f,0xbf,0xdf,0xef,0xf7,0xfb,0xfd,0xfe};
unsigned char code CHARCODE[CHARCADE_rowLength][CHARCADE_columnLength]=
{
	{0x00,0x00,0x3e,0x41,0x41,0x41,0x3e,0x00}, //0

	{0x00,0x00,0x00,0x00,0x21,0x7f,0x01,0x00}, //1
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	{0x7C,0x48,0x48,0xFF,0x48,0x48,0x7C,0x00}  //??
};

void module11_delay(unsigned int time);
void Hc595SendByte(unsigned char dat);

void module11_delay(unsigned int time){
  unsigned int i,j;
  for(i=0;i<time;i++)
    for(j=0;j<121;j++);
}

void Hc595SendByte(unsigned char dat)
{
    unsigned char a;
    module11_SRCLK=0;
    module11_RCLK=0;
    for(a=0;a<8;a++)
    {
       module11_SER=dat>>7;
       dat<<=1;

       module11_SRCLK=1;
       _nop_();
       _nop_();
       module11_SRCLK=0;    
    }

    module11_RCLK=1;
    _nop_();
    _nop_();
    module11_RCLK=0;
}

void main()
{   
    unsigned char tab, j;
    unsigned int  i;

    while(1)
    {   
        for(i= 0; i<50; i++)
        {
            for(tab=0;tab<TAB_length;tab++)
            {   
                Hc595SendByte(0x00);                 
                COMMONPORTS = TAB[tab];              
                Hc595SendByte(CHARCODE[j][tab]);    
                module11_delay(2);       
            }
        }
        j++;
        if(j == 18)
        {
            j = 0;
        }
    }   
}

